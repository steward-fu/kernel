## sound/soc/suniv/Kconfig
```kconfig
config SND_SUNIV_CODEC
	tristate "audio codec driver for allwinner suniv handheld"
	select SND_SOC_GENERIC_DMAENGINE_PCM
	select REGMAP_MMIO
	help
	  Select Y or M to add support for the Codec embedded in the Allwinner
	  A10 and affiliated SoCs.
```
